## br2_external_bitmain/board/x19_xilinx/ramdisk.its
```
/dts-v1/;

/ {
    description = "HashSource Ramdisk";
    #address-cells = <1>;

    images {
        ramdisk {
            description = "HashSource Ramdisk";
            data = /incbin/("rootfs.ext2.gz");
            type = "ramdisk";
            arch = "arm";
            os = "linux";
            compression = "gzip";
        };
    };

    configurations {
        default = "config-1";

        config-1 {
            description = "Default configuration";
            ramdisk = "ramdisk";
        };
    };
};
```

## br2_external_bitmain/configs/x19_xilinx_ramdisk_defconfig
```kconfig
# shellcheck disable=SC2148

# Architecture
BR2_arm=y
BR2_cortex_a9=y
BR2_ARM_ENABLE_NEON=y
BR2_ARM_ENABLE_VFP=y
BR2_ARM_FPU_VFPV3D16=y

# Global patch directory for package patches
BR2_GLOBAL_PATCH_DIR="$(BR2_EXTERNAL_X19_BITMAIN_PATH)/board/x19_xilinx/patches"

# Toolchain - MUST match stock kernel 4.6.0-xilinx exactly
BR2_TOOLCHAIN_BUILDROOT_GLIBC=y
# Kernel headers 4.6.x for userspace ABI compatibility with stock kernel
# Using custom tarball since 4.6 was removed from Buildroot in 2017.02
# Declaring as 4.4.x series (4.6 is compatible with 4.4 ABI)
BR2_KERNEL_HEADERS_CUSTOM_TARBALL=y
BR2_KERNEL_HEADERS_CUSTOM_TARBALL_LOCATION="https://cdn.kernel.org/pub/linux/kernel/v4.x/linux-4.6.tar.xz"
BR2_PACKAGE_HOST_LINUX_HEADERS_CUSTOM_4_6=y
BR2_TOOLCHAIN_BUILDROOT_CXX=y
# Use default GCC version (currently 14.x)

# System configuration
BR2_TARGET_GENERIC_HOSTNAME="HashSource"
BR2_TARGET_GENERIC_ISSUE="HashSource X19"
BR2_ROOTFS_DEVICE_CREATION_DYNAMIC_MDEV=y
BR2_ROOTFS_OVERLAY="$(BR2_EXTERNAL_X19_BITMAIN_PATH)/board/x19_xilinx/rootfs-overlay"
# Root password = "root" (for development/testing)
BR2_TARGET_GENERIC_ROOT_PASSWD="root"
BR2_SYSTEM_DHCP="eth0"
# Use bash as default shell
BR2_SYSTEM_BIN_SH_BASH=y

# Build options - optimize for size
BR2_OPTIMIZE_S=y
BR2_ENABLE_LTO=y

# NO BOOTLOADER - Using stock BOOT.bin from NAND
# BR2_TARGET_UBOOT is not set

# NO KERNEL - Using stock kernel from NAND at 0x2000000
# BR2_LINUX_KERNEL is not set

# Filesystem - ext4 ramdisk for FIT image packaging
BR2_TARGET_ROOTFS_EXT2=y
BR2_TARGET_ROOTFS_EXT2_4=y
BR2_TARGET_ROOTFS_EXT2_SIZE="32M"

# Essential packages only
BR2_PACKAGE_BUSYBOX=y
BR2_PACKAGE_BUSYBOX_CONFIG="$(BR2_EXTERNAL_X19_BITMAIN_PATH)/board/x19_xilinx/busybox.config"
BR2_PACKAGE_BUSYBOX_SHOW_OTHERS=y

# Shell
BR2_PACKAGE_BASH=y
BR2_PACKAGE_BASH_COMPLETION=y
BR2_PACKAGE_NCURSES=y
BR2_PACKAGE_READLINE=y

# Network tools
BR2_PACKAGE_DROPBEAR=y
BR2_PACKAGE_ETHTOOL=y
BR2_PACKAGE_ETHTOOL_PRETTY_PRINT=y

# System utilities
BR2_PACKAGE_I2C_TOOLS=y
BR2_PACKAGE_MTD=y
BR2_PACKAGE_MTD_NANDWRITE=y
BR2_PACKAGE_MTD_NANDDUMP=y
BR2_PACKAGE_MTD_FLASH_ERASE=y
BR2_PACKAGE_UTIL_LINUX=y
BR2_PACKAGE_UTIL_LINUX_BINARIES=y

# Host U-Boot tools with FIT support for ramdisk.itb creation
BR2_PACKAGE_HOST_UBOOT_TOOLS_FIT_SUPPORT=y

# Host genimage for SD card image creation
BR2_PACKAGE_HOST_GENIMAGE=y
BR2_PACKAGE_HOST_MTOOLS=y
BR2_PACKAGE_HOST_DOSFSTOOLS=y

# Custom X19 packages
# NOTE: Stock kernel modules are in rootfs-overlay, not built from source
BR2_PACKAGE_HASHSOURCE_X19=y

# Build scripts
BR2_ROOTFS_POST_BUILD_SCRIPT="$(BR2_EXTERNAL_X19_BITMAIN_PATH)/board/x19_xilinx/post-build.sh"
BR2_ROOTFS_POST_IMAGE_SCRIPT="$(BR2_EXTERNAL_X19_BITMAIN_PATH)/board/x19_xilinx/post-image-ramdisk.sh"

# Host tools for FIT image creation
BR2_PACKAGE_HOST_DTC=y
BR2_PACKAGE_HOST_UBOOT_TOOLS=y
```

## br2_external_bitmain/packages/hashsource_x19/Config.in
```kconfig
config BR2_PACKAGE_HASHSOURCE_X19
	bool "hashsource_x19 (C build only)"
	help
	  HashSource custom mining software (C implementation)

	  NOTE: Builds C binaries for reference but does NOT install
	  to rootfs. Use hashsource_x19_rs for production.

	  Supports X19 Xilinx Zynq platform.
```

## br2_external_bitmain/packages/hashsource_x19_rs/Config.in
```kconfig
config BR2_PACKAGE_HASHSOURCE_X19_RS
	bool "hashsource_x19_rs"
	depends on BR2_PACKAGE_HOST_RUSTC_TARGET_ARCH_SUPPORTS
	select BR2_PACKAGE_HOST_RUSTC
	help
	  HashSource X19 mining software Rust implementation.

	  Hardware control utilities for Bitmain Antminer S19
	  family ASIC miners.
```
